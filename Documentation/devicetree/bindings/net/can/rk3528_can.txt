## Documentation/devicetree/bindings/net/can/rk3528_can.txt
```
Rockchip CANFD controller Device Tree Bindings
---------------------------------------------------------

Required properties:
- compatible		: Should be:
			  - "rockchip,rk3528-can" for RK3528 CAN controllers 1.0
- reg			: Physical base address and size of the controller
			  registers map.
- interrupts		: Property with a value describing the interrupt
			  number.
- clock-names		: List of input clock names
			  - "can_clk", "pclk",
			  (See clock bindings for details).
- clocks		: Clock phandles (see clock bindings for details).
- resets : Must contain an entry for each entry in reset-names.
	   See ../reset/reset.txt for details.
- reset-names : List of input reset names
			  - "can", "can-apb".

Example:

For Dts file:
	can0: can0@ff960000 {
		compatible = "rockchip,rk3528-can";
		reg = <0x0 0xff960000 0x0 0x1000>;
		interrupts = <GIC_SPI 48 IRQ_TYPE_LEVEL_HIGH>;
		clocks = <&cru CLK_CAN0>, <&cru PCLK_CAN0>;
		clock-names = "baudclk", "apb_pclk";
		resets = <&cru SRST_CAN0>, &cru SRST_P_CAN0>;
		reset-names = "can", "can-apb";
		status = "okay";
	};
```
