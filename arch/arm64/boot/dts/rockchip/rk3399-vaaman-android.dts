// SPDX-License-Identifier: (GPL-2.0+ OR MIT)
/*
 * Copyright (C) 2023 Vicharak Computers LLP
 */

/dts-v1/;

#include "rk3399-vaaman.dtsi"
#include "rk3399-android.dtsi"

/ {
	model = "Vicharak RK3399 VAAMAN VO.3 ANDROID";
	compatible = "vicharak,rk3399-vaaman", "rockchip,rk3399";
};
