// SPDX-License-Identifier: GPL-2.0+
// Copyright (C) 2023 Vicharak Computers LLP

/dts-v1/;
/plugin/;

/ {
	metadata {
		title = "Set OTG port to Host mode on Vicharak Vaaman";
		compatible = "vicharak,rk3399-vaaman", "rockchip,rk3399";
		category = "misc";
		exclusive = "usbdrd_dwc3_0-dr_mode";
		description = "Set OTG port to Host mode.\nUse this when you want to connect USB devices.";
	};

	fragment@0 {
		target = <&usbdrd_dwc3_0>;

		__overlay__ {
			status = "okay";
			dr_mode = "host";
		};
	};
};
