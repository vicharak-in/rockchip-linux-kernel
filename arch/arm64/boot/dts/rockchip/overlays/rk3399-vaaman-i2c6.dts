// SPDX-License-Identifier: GPL-2.0+
// Copyright (C) 2023 Vicharak Computers LLP

/dts-v1/;
/plugin/;

/ {
	metadata {
		title = "Enable i2c6";
		compatible = "rockchip,rk3399";
		category = "misc";
		exclusive = "GPIO2_A0", "GPIO2_A1";
		description = "Enable i2c6 on pin GPIO2_B1 (31) SDA & GPIO2_B2 (29) SCL.";
	};

	fragment@0 {
		target = <&i2c6>;

		__overlay__ {
			status = "okay";
			pinctrl-names = "default";
			pinctrl-0 = <&i2c6_xfer>;
		};
	};
};

