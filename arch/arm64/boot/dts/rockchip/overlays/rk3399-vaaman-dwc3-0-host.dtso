// SPDX-License-Identifier: GPL-2.0+
// Copyright (C) 2023 Vicharak Computers LLP

/dts-v1/;
/plugin/;

&{/} {
	metadata {
		title = "Set OTG port to Host mode";
		compatible = "vicharak,rk3399-vaaman", "rockchip,rk3399";
		category = "misc";
		exclusive = "usbdrd_dwc3_0-dr_mode";
		description = "Switch the OTG port to Host mode for connecting USB devices.";
	};
};

&usbdrd_dwc3_0 {
	status = "okay";
	dr_mode = "host";
};
