// SPDX-License-Identifier: GPL-2.0+
// Copyright (C) 2023 Vicharak Computers LLP

/dts-v1/;
/plugin/;

/ {
	metadata {
		title = "Enable I2S 1 channel on Vicharak Vaaman";
		compatible = "vicharak,rk3399-vaaman", "rockchip,rk3399";
		category = "misc";
		exclusive = "i2s1";
		description = "Enables I2S 1 channel on Vicharak Vaaman to be used for external audio";
	};

	fragment@0 {
		target = <&i2s1>;

		__overlay__ {
			status = "okay";
			rockchip,playback-channels = <2>;
			rockchip,capture-channels = <2>;
		};
	};
};
