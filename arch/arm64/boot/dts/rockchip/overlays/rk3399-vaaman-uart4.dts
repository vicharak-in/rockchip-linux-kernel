// SPDX-License-Identifier: GPL-2.0+
// Copyright (C) 2023 Vicharak Computers LLP

/dts-v1/;
/plugin/;

/ {
	metadata {
		title = "Enable UART4";
		compatible = "vicharak,rk3399-vaaman", "rockchip,rk3399";
		category = "misc";
		exclusive = "GPIO1_B0", "GPIO1_A7";
		description = "Enable UART4.";
	};

	fragment@0 {
		target = <&uart4>;

		__overlay__ {
			status = "okay";
			pinctrl-names = "default";
			pinctrl-0 = <&uart4_xfer>;
		};
	};
};
