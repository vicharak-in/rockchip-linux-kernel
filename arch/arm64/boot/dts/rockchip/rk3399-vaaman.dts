// SPDX-License-Identifier: (GPL-2.0+ OR MIT)
/*
 * Copyright (C) 2023 Vicharak India
 */

/dts-v1/;

#include "rk3399-vaaman.dtsi"

/ {
	model = "Vicharak RK3399 VAAMAN VO.3";
	compatible = "vicharak,rk3399-vaaman", "rockchip,rk3399";
};
